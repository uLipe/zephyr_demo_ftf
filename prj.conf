## prj.conf
```kconfig
#
# Automatically generated file; DO NOT EDIT.
# Zephyr Kernel Configuration
#
# CONFIG_ARC is not set
CONFIG_ARM=y
# CONFIG_X86 is not set
# CONFIG_NIOS2 is not set
CONFIG_SYS_POWER_LOW_POWER_STATE_SUPPORTED=y
# CONFIG_SYS_POWER_DEEP_SLEEP_SUPPORTED is not set
CONFIG_ARCH="arm"
CONFIG_SOC="mk64f12"
CONFIG_SOC_SERIES="k6x"
CONFIG_SOC_FAMILY="nxp_kinetis"
CONFIG_BOARD="frdm_k64f"
CONFIG_ARCH_DEFCONFIG="arch/arm/defconfig"
CONFIG_DATA_ENDIANNESS_LITTLE=y
CONFIG_NUM_IRQS=86
CONFIG_FAULT_DUMP=2
# CONFIG_IRQ_OFFLOAD is not set
CONFIG_XIP=y
CONFIG_SRAM_SIZE=192
CONFIG_SRAM_BASE_ADDRESS=0x20000000
CONFIG_FLASH_SIZE=1024
CONFIG_FLASH_BASE_ADDRESS=0x00000000
CONFIG_SW_ISR_TABLE=y
CONFIG_ARCH_HAS_TASK_ABORT=y
CONFIG_ARCH_HAS_NANO_FIBER_ABORT=y
# CONFIG_SOC_ATMEL_SAM3X8E is not set
# CONFIG_SOC_SERIES_NRF51X is not set
# CONFIG_SOC_SERIES_NRF52X is not set
CONFIG_SOC_SERIES_KINETIS_K6X=y
# CONFIG_SOC_SERIES_STM32F1X is not set
# CONFIG_SOC_SERIES_STM32F4X is not set
# CONFIG_SOC_TI_LM3S6965 is not set
# CONFIG_SOC_SERIES_CC32XX is not set

#
# ARM Options
#
CONFIG_CPU_CORTEX=y
CONFIG_CPU_CORTEX_M=y
CONFIG_CPU_HAS_FPU=y

#
# Floating Point Options
#
CONFIG_FLOAT=y
# CONFIG_FP_SHARING is not set
CONFIG_FP_HARDABI=y
# CONFIG_FP_SOFTABI is not set
CONFIG_ISA_THUMB2=y
# CONFIG_CPU_CORTEX_M0_M0PLUS is not set
CONFIG_CPU_CORTEX_M3_M4=y
CONFIG_CPU_CORTEX_M4=y
# CONFIG_CPU_CORTEX_M7 is not set

#
# ARM Cortex-M options
#
CONFIG_LDREX_STREX_AVAILABLE=y
CONFIG_STACK_ALIGN_DOUBLE_WORD=y
CONFIG_NUM_IRQ_PRIO_BITS=4
# CONFIG_RUNTIME_NMI is not set

#
# ARM Cortex-M0/M0+/M3/M4/M7 options
#
CONFIG_IRQ_VECTOR_TABLE_SOC=y
# CONFIG_ZERO_LATENCY_IRQS is not set

#
# Board Configuration
#
# CONFIG_SOC_ATMEL_SAM3 is not set
# CONFIG_SOC_FAMILY_NRF5 is not set
CONFIG_SOC_FAMILY_KINETIS=y
CONFIG_SOC_MK64F12=y
CONFIG_SOC_PART_NUMBER_MK64FN1M0VLL12=y
CONFIG_SOC_PART_NUMBER_KINETIS_K6X="MK64FN1M0VLL12"
CONFIG_K64_CORE_CLOCK_DIVIDER=1
CONFIG_K64_BUS_CLOCK_DIVIDER=2
CONFIG_K64_FLEXBUS_CLOCK_DIVIDER=3
CONFIG_K64_FLASH_CLOCK_DIVIDER=5
CONFIG_WDOG_INIT=y
CONFIG_PRESERVE_JTAG_IO_PINS=y
CONFIG_SOC_PART_NUMBER="MK64FN1M0VLL12"
CONFIG_HAS_OSC=y
CONFIG_HAS_MCG=y
CONFIG_HAS_RNGA=y
CONFIG_OSC_EXTERNAL=y
# CONFIG_OSC_LOW_POWER is not set
# CONFIG_OSC_HIGH_GAIN is not set
CONFIG_OSC_XTAL0_FREQ=50000000
CONFIG_MCG_PRDIV0=0x13
CONFIG_MCG_VDIV0=0x18
CONFIG_MCG_FCRDIV=1
# CONFIG_SOC_FAMILY_STM32 is not set
# CONFIG_SOC_FAMILY_TISIMPLELINK is not set
CONFIG_BOARD_FRDM_K64F=y
# CONFIG_BOARD_HEXIWEAR_K64 is not set

#
# Board Options
#
CONFIG_KERNEL_V2=y
# CONFIG_NANOKERNEL is not set
CONFIG_MICROKERNEL=y

#
# General Kernel Options
#
CONFIG_SYS_CLOCK_TICKS_PER_SEC=100
CONFIG_SYS_CLOCK_HW_CYCLES_PER_SEC=120000000
CONFIG_SYS_CLOCK_EXISTS=y
CONFIG_INIT_STACKS=y
# CONFIG_RING_BUFFER is not set
# CONFIG_KERNEL_EVENT_LOGGER is not set
# CONFIG_THREAD_MONITOR is not set
CONFIG_KERNEL_INIT_PRIORITY_OBJECTS=30
CONFIG_KERNEL_INIT_PRIORITY_DEFAULT=40
CONFIG_KERNEL_INIT_PRIORITY_DEVICE=50
CONFIG_APPLICATION_INIT_PRIORITY=90

#
# Security Options
#
# CONFIG_STACK_CANARIES is not set
# CONFIG_BOOT_BANNER is not set
# CONFIG_BUILD_TIMESTAMP is not set
CONFIG_MAIN_STACK_SIZE=1024
CONFIG_ISR_STACK_SIZE=2048
# CONFIG_THREAD_CUSTOM_DATA is not set
CONFIG_NANO_TIMEOUTS=y
CONFIG_NANO_TIMERS=y
# CONFIG_NANOKERNEL_TICKLESS_IDLE_SUPPORTED is not set
CONFIG_ERRNO=y
CONFIG_SYSTEM_WORKQUEUE_STACK_SIZE=1024
CONFIG_SYSTEM_WORKQUEUE_PRIORITY=-1
CONFIG_ATOMIC_OPERATIONS_BUILTIN=y

#
# Unified Kernel Options
#
# CONFIG_KERNEL_V2_DEBUG is not set
CONFIG_NUM_COOP_PRIORITIES=16
CONFIG_NUM_PREEMPT_PRIORITIES=15
CONFIG_PRIORITY_CEILING=0
CONFIG_MAIN_THREAD_PRIORITY=0
CONFIG_IDLE_STACK_SIZE=256
CONFIG_NUM_DYNAMIC_TIMERS=0
CONFIG_OFFLOAD_WORKQUEUE_STACK_SIZE=1024
CONFIG_OFFLOAD_WORKQUEUE_PRIORITY=-1
CONFIG_NUM_MBOX_ASYNC_MSGS=10
CONFIG_NUM_PIPE_ASYNC_MSGS=10

#
# Timer API Options
#
CONFIG_TIMESLICING=y
CONFIG_TIMESLICE_SIZE=0
CONFIG_TIMESLICE_PRIORITY=0
CONFIG_SEMAPHORE_GROUPS=y
# CONFIG_MEM_POOL_AD_NONE is not set
# CONFIG_MEM_POOL_AD_BEFORE_SEARCH_FOR_BIGGERBLOCK is not set
CONFIG_MEM_POOL_AD_AFTER_SEARCH_FOR_BIGGERBLOCK=y
CONFIG_HEAP_MEM_POOL_SIZE=0

#
# Power Management
#
# CONFIG_SYS_POWER_MANAGEMENT is not set
CONFIG_MDEF=y

#
# Device Drivers
#
CONFIG_CONSOLE=y
CONFIG_CONSOLE_HAS_DRIVER=y
# CONFIG_CONSOLE_HANDLER is not set
CONFIG_UART_CONSOLE=y
CONFIG_UART_CONSOLE_ON_DEV_NAME="UART_0"
CONFIG_UART_CONSOLE_INIT_PRIORITY=60
# CONFIG_UART_CONSOLE_DEBUG_SERVER_HOOKS is not set
# CONFIG_RAM_CONSOLE is not set
# CONFIG_IPM_CONSOLE_SENDER is not set
# CONFIG_IPM_CONSOLE_RECEIVER is not set
# CONFIG_UART_PIPE is not set
# CONFIG_ENABLE_SHELL is not set
CONFIG_SERIAL=y

#
# Capabilities
#
CONFIG_SERIAL_HAS_DRIVER=y
# CONFIG_UART_INTERRUPT_DRIVEN is not set
# CONFIG_UART_LINE_CTRL is not set
# CONFIG_UART_DRV_CMD is not set

#
# Serial Drivers
#
# CONFIG_UART_NS16550 is not set
CONFIG_UART_K20=y
CONFIG_UART_K20_PORT_0=y
CONFIG_UART_K20_PORT_0_NAME="UART_0"
CONFIG_UART_K20_PORT_0_IRQ_PRI=3
CONFIG_UART_K20_PORT_0_BAUD_RATE=115200
CONFIG_UART_K20_PORT_1=y
CONFIG_UART_K20_PORT_1_NAME="UART_1"
CONFIG_UART_K20_PORT_1_IRQ_PRI=3
CONFIG_UART_K20_PORT_1_BAUD_RATE=115200
CONFIG_UART_K20_PORT_2=y
CONFIG_UART_K20_PORT_2_NAME="UART_2"
CONFIG_UART_K20_PORT_2_IRQ_PRI=3
CONFIG_UART_K20_PORT_2_BAUD_RATE=115200
CONFIG_UART_K20_PORT_3=y
CONFIG_UART_K20_PORT_3_NAME="UART_3"
CONFIG_UART_K20_PORT_3_IRQ_PRI=3
CONFIG_UART_K20_PORT_3_BAUD_RATE=115200
CONFIG_UART_K20_PORT_4=y
CONFIG_UART_K20_PORT_4_NAME="UART_4"
CONFIG_UART_K20_PORT_4_IRQ_PRI=3
CONFIG_UART_K20_PORT_4_BAUD_RATE=115200
# CONFIG_UART_STELLARIS is not set
# CONFIG_UART_ALTERA_JTAG is not set

#
# Interrupt Controllers
#

#
# Timer Drivers
#
CONFIG_CORTEX_M_SYSTICK=y
# CONFIG_SYSTEM_CLOCK_DISABLE is not set
# CONFIG_TIMER_READS_ITS_FREQUENCY_AT_RUNTIME is not set
CONFIG_SYSTEM_CLOCK_INIT_PRIORITY=0

#
# Random Generation Configuration
#
CONFIG_RANDOM_GENERATOR=y
CONFIG_RANDOM_KSDK=y
# CONFIG_GROVE is not set
CONFIG_GPIO=y
CONFIG_SYS_LOG_GPIO_LEVEL=0
# CONFIG_GPIO_DW is not set
# CONFIG_GPIO_PCAL9535A is not set
# CONFIG_GPIO_MMIO is not set
# CONFIG_GPIO_SCH is not set
CONFIG_GPIO_K64=y
CONFIG_PORT_K64_INT_STATUS_OFFSET=0xA0
CONFIG_GPIO_K64_A=y
CONFIG_GPIO_K64_A_DEV_NAME="GPIO_0"
CONFIG_GPIO_K64_PORTA_PRI=2
CONFIG_GPIO_K64_B=y
CONFIG_GPIO_K64_B_DEV_NAME="GPIO_1"
CONFIG_GPIO_K64_PORTB_PRI=2
CONFIG_GPIO_K64_C=y
CONFIG_GPIO_K64_C_DEV_NAME="GPIO_2"
CONFIG_GPIO_K64_PORTC_PRI=2
CONFIG_GPIO_K64_D=y
CONFIG_GPIO_K64_D_DEV_NAME="GPIO_3"
CONFIG_GPIO_K64_PORTD_PRI=2
CONFIG_GPIO_K64_E=y
CONFIG_GPIO_K64_E_DEV_NAME="GPIO_4"
CONFIG_GPIO_K64_PORTE_PRI=2
# CONFIG_SHARED_IRQ is not set
# CONFIG_SPI is not set
CONFIG_I2C=y
# CONFIG_I2C_DW is not set
CONFIG_I2C_KSDK=y
CONFIG_I2C_INIT_PRIORITY=60
CONFIG_I2C_CLOCK_SPEED=32
CONFIG_SYS_LOG_I2C_LEVEL=0
# CONFIG_I2C_SHARED_IRQ is not set
CONFIG_I2C_0_IRQ_DIRECT=y
CONFIG_I2C_0=y
CONFIG_I2C_0_NAME="I2C_0"
CONFIG_I2C_0_DEFAULT_CFG=0x12
CONFIG_I2C_0_IRQ_PRI=0
# CONFIG_I2C_1 is not set
# CONFIG_PWM is not set
CONFIG_PINMUX=y
# CONFIG_PINMUX_DEV is not set
CONFIG_PINMUX_NAME="PINMUX"
CONFIG_PINMUX_INIT_PRIORITY=60
CONFIG_PINMUX_K64=y
# CONFIG_ADC is not set
# CONFIG_RTC is not set
# CONFIG_WATCHDOG is not set
# CONFIG_CLOCK_CONTROL is not set
# CONFIG_IPM is not set
# CONFIG_AIO_COMPARATOR is not set
# CONFIG_FLASH is not set
# CONFIG_SENSOR is not set
# CONFIG_COUNTER is not set
# CONFIG_DMA is not set
# CONFIG_USB is not set

#
# Networking
#
# CONFIG_NETWORKING is not set
# CONFIG_NET_BUF is not set

#
# Compile and Link Features
#
CONFIG_KERNEL_BIN_NAME="zephyr"
CONFIG_TEXT_SECTION_OFFSET=0
# CONFIG_HAVE_CUSTOM_LINKER_SCRIPT is not set
CONFIG_CROSS_COMPILE=""
# CONFIG_GDB_INFO is not set
# CONFIG_LINK_WHOLE_ARCHIVE is not set
CONFIG_COMPILER_OPT=""
CONFIG_TOOLCHAIN_VARIANT=""
# CONFIG_CPLUSPLUS is not set
CONFIG_MINIMAL_LIBC=y
# CONFIG_NEWLIB_LIBC is not set
# CONFIG_MINIMAL_LIBC_EXTENDED is not set

#
# Debugging Options
#
CONFIG_DEBUG=y
# CONFIG_TASK_DEBUG is not set
# CONFIG_STACK_USAGE is not set
CONFIG_PRINTK=y
CONFIG_STDOUT_CONSOLE=y
# CONFIG_EARLY_CONSOLE is not set
# CONFIG_ASSERT is not set
# CONFIG_DEBUG_TRACING_KERNEL_OBJECTS is not set
# CONFIG_OMIT_FRAME_POINTER is not set

#
# Safe memory access
#
# CONFIG_MEM_SAFE is not set
# CONFIG_GDB_SERVER is not set

#
# Logging Options
#
CONFIG_SYS_LOG=y
CONFIG_SYS_LOG_SHOW_TAGS=y
# CONFIG_SYS_LOG_SHOW_COLOR is not set
CONFIG_SYS_LOG_DEFAULT_LEVEL=0
CONFIG_SYS_LOG_OVERRIDE_LEVEL=0

#
# System Monitoring Options
#
# CONFIG_PERFORMANCE_METRICS is not set

#
# Boot Options
#
# CONFIG_IS_BOOTLOADER is not set
# CONFIG_REBOOT is not set

#
# Cryptography
#

#
# IoT Protocols
#
# CONFIG_ZOAP is not set

#
# File System
#
# CONFIG_FILE_SYSTEM is not set
# CONFIG_BLUETOOTH is not set

#
# External Sources
#

#
# HALs
#
CONFIG_HAS_CMSIS=y
CONFIG_HAS_KSDK=y

#
# Cryptography
#
# CONFIG_TINYCRYPT is not set
# CONFIG_MBEDTLS is not set

#
# File Systems
#

#
# Testing
#
# CONFIG_ZTEST is not set
```

## src/main.c
```c
/*
 * Copyright (c) 2012-2014 Wind River Systems, Inc.
 *
 * Licensed under the Apache License, Version 2.0 (the "License");
 * you may not use this file except in compliance with the License.
 * You may obtain a copy of the License at
 *
 *     http://www.apache.org/licenses/LICENSE-2.0
 *
 * Unless required by applicable law or agreed to in writing, software
 * distributed under the License is distributed on an "AS IS" BASIS,
 * WITHOUT WARRANTIES OR CONDITIONS OF ANY KIND, either express or implied.
 * See the License for the specific language governing permissions and
 * limitations under the License.
 */

#include <zephyr.h>
#include <misc/printk.h>

void main(void)
{
	printk("***********************************************************************\n\r");
	printk("******          FTF Connects 2016 Zephyr Demo App  			***********\n\r");
	printk("******             Starting the application! 			     **********\n\r");
	printk("***********************************************************************\n\r");

}
```

## src/acc_app.c
```c
/**
 * 		FTF Connect 2016 - Zephyr RTOS demo
 *
 *	 @brief acelerometer readings thread application
 *
 */

#include <stdio.h>
#include <stdint.h>
#include <zephyr.h>
#include <misc/printk.h>
#include <device.h>
#include <i2c.h>

#include "acc_board_def.h"



/** defines the read period of acc task */
#define ACC_TASK_EXEC_PERIOD 200

/** define the full scale acceleration convesion factor */
#define ACC_CONVERSION_FACTOR_4G 0.000488f

/* i2c acelerometer device instance */
struct device *acc_wire_dev = NULL;

extern struct k_sem sync;


/* accelerometer typical variables */
int16_t x = 0;
int16_t y = 0;
int16_t z = 0;



/**
 * @brief accelerometer thread application
 */
void acc_thread(void)
{
	int rc = 0;
	uint8_t acc_whoami;

	/* open i2c used to accelerometer */
	acc_wire_dev = device_get_binding("I2C_0");
	if(acc_wire_dev == NULL) {
		printk("acc_thread: failed to open the acc_device \n\r");
		return;
	}else{
		printk("acc_thread: opened the acc_device \n\r");
	}

	int dev_cfg = I2C_SPEED_FAST << 1 | I2C_MODE_MASTER;

	/* configure the i2c */
	rc = i2c_configure(acc_wire_dev, dev_cfg);

	if(rc != 0) {
		printk("acc_thread: failed to configure the accel i2c as master \n\r");
		return;
	} else {
		printk("acc_thread: configured the accel interface, speed: %s \n\r",
					((dev_cfg >> 1 & I2C_SPEED_FAST) != 0 ? "400kbps": "100kbps" ));
	}


	/* check if the accel is up */
	rc = i2c_burst_read(acc_wire_dev,FXOS8700CQ_SLAVE_ADDR1,FXOS8700CQ_WHOAMI,
							&acc_whoami, sizeof(acc_whoami));

	if(rc != 0) {
		printk("acc_thread: acc failed to read FXOS8700CQ_WHOAMI\n\r");
		return;
	} else {
		printk("acc_thread: acc read %d bytes from FXOS8700CQ_WHOAMI \n\r", sizeof(acc_whoami));
	}

	/* is who am I expected value? */
	if(acc_whoami != FXOS8700CQ_WHOAMI_VAL) {
		printk("acc_thread: warning, accel whoami is invalid! \n\r");
	}

	printk("acc_thread: configuring! \n\r");

	/* do a basic configuration on accel */
	{
		uint8_t data_buf[8] = {0};

		/* suspend the acc */
		rc = i2c_reg_write_byte(acc_wire_dev, FXOS8700CQ_SLAVE_ADDR1, FXOS8700CQ_CTRL_REG1, 0);

		if(rc != 0) {
			printk("acc_thread: acc failed to write FXOS8700CQ_CTRL_REG1\n\r");
			return;
		} else {
			printk("acc_thread: acc wrote %d bytes into FXOS8700CQ_CTRL_REG1 \n\r", sizeof(data_buf[0]));
		}

		/*
		 * configure the acc as:
		 *
		 * - sleep rate of 12.5Hz
		 * - ODR of 400Hz/200Hz hybrid
		 * - low power sleep oversampling mode
		 * - low noise, low power oversampling mode
		 *
		 */
		data_buf[1] = 0;
		data_buf[2] = 0x1F;
		data_buf[3] = 0x20;
		data_buf[4] = 0x01;

		rc = i2c_reg_write_byte(acc_wire_dev, FXOS8700CQ_SLAVE_ADDR1, FXOS8700CQ_CTRL_REG1, data_buf[1]);
		if(rc != 0) {
			printk("acc_thread: failed to write to acc register! \n\r");
			return;
		} else {
			printk("acc_thread: successful  write to acc register! \n\r");
		}
		rc = i2c_reg_write_byte(acc_wire_dev, FXOS8700CQ_SLAVE_ADDR1, FXOS8700CQ_M_CTRL_REG1, data_buf[2]);
		if(rc != 0) {
			printk("acc_thread: failed to write to acc register! \n\r");
			return;

		} else {
			printk("acc_thread: successful  write to acc register! \n\r");
		}

		rc = i2c_reg_write_byte(acc_wire_dev, FXOS8700CQ_SLAVE_ADDR1, FXOS8700CQ_M_CTRL_REG2, data_buf[3]);
		if(rc != 0) {
			printk("acc_thread: failed to write to acc register! \n\r");
			return;

		} else {
			printk("acc_thread: successful  write to acc register! \n\r");
		}

		rc = i2c_reg_write_byte(acc_wire_dev, FXOS8700CQ_SLAVE_ADDR1, FXOS8700CQ_XYZ_DATA_CFG, data_buf[4]);
		if(rc != 0) {
			printk("acc_thread: failed to write to acc register! \n\r");
			return;

		} else {
			printk("acc_thread: successful  write to acc register! \n\r");
		}


		data_buf[0] = 0x0D;
		rc = i2c_reg_write_byte(acc_wire_dev,FXOS8700CQ_SLAVE_ADDR1,FXOS8700CQ_CTRL_REG1,data_buf[0]);
		if(rc != 0) {
			printk("acc_thread: failed to write to acc register! \n\r");
			return;

		} else {
			printk("acc_thread: successful  write to acc register! \n\r");
		}
	}

	printk("acc_thread: acc is configured and ready to operate \n\r");


	for(;;) {

		volatile float gx, gy, gz;

		uint8_t acc_raw_data[7] = {0};
		rc = i2c_burst_read(acc_wire_dev,FXOS8700CQ_SLAVE_ADDR1, FXOS8700CQ_STATUS,
				&acc_raw_data[0], sizeof(acc_raw_data));

		if(rc != 0) {
			printk("acc_thread: failed to read the accelerometer acc registrers! \n\r");
		} else {
			printk("acc_thread: read the acc from register in accelerometer! \n\r \n\r \n\r");
		}


		/* printts the accel status */
		printk("acc_thread: accelerometer status is: 0x%x \n\r", acc_raw_data[0]);

		/* obtain the raw accelerations */
		x = (int16_t)(((acc_raw_data[1] << 8) | acc_raw_data[2]))>> 2;
		y = (int16_t)(((acc_raw_data[3] << 8) | acc_raw_data[4]))>> 2;
		z = (int16_t)(((acc_raw_data[5] << 8) | acc_raw_data[6]))>> 2;


		/* calculate the acceleration based in g value */
		gx = (float)x * ACC_CONVERSION_FACTOR_4G;
		gy = (float)y * ACC_CONVERSION_FACTOR_4G;
		gz = (float)z * ACC_CONVERSION_FACTOR_4G;


		/* show the current readings */
		printf("acc_thread: x axis raw reading: %f \n\r", gx);
		printf("acc_thread: y axis raw reading: %f \n\r", gy);
		printf("acc_thread: z axis raw reading: %f \n\r", gz);

		k_sem_give(&sync);

		/* wait for next executions */
		task_sleep(ACC_TASK_EXEC_PERIOD);
	}
}
```

## src/acc_board_def.h
```c
/*
 * acc_board_def.h
 *
 *  Created on: Oct 30, 2016
 *      Author: user
 */

#ifndef SRC_ACC_BOARD_DEF_H_
#define SRC_ACC_BOARD_DEF_H_

// FXOS8700CQ I2C address
#define FXOS8700CQ_SLAVE_ADDR0 (0x1E) // with pins SA0=0, SA1=0
#define FXOS8700CQ_SLAVE_ADDR1 (0x1D) // with pins SA0=1, SA1=0
#define FXOS8700CQ_SLAVE_ADDR2 (0x1C) // with pins SA0=0, SA1=1
#define FXOS8700CQ_SLAVE_ADDR3 (0x1F) // with pins SA0=1, SA1=1

// FXOS8700CQ internal register addresses
#define FXOS8700CQ_STATUS 0x00
#define FXOS8700CQ_OUT_X_MSB 0x01
#define FXOS8700CQ_WHOAMI 0x0D
#define FXOS8700CQ_M_OUT_X_MSB 0x33

#define FXOS8700CQ_XYZ_DATA_CFG 0x0E

#define FXOS8700CQ_CTRL_REG1 0x2A
#define FXOS8700CQ_CTRL_REG2 0x2B
#define FXOS8700CQ_CTRL_REG3 0x2C
#define FXOS8700CQ_CTRL_REG4 0x2D
#define FXOS8700CQ_CTRL_REG5 0x2E

#define FXOS8700CQ_M_CTRL_REG1 0x5B
#define FXOS8700CQ_M_CTRL_REG2 0x5C
#define FXOS8700CQ_M_CTRL_REG3 0x5D

// FXOS8700CQ configuration macros, per register

#define FXOS8700CQ_CTRL_REG1_ASLP_RATE2(x) (x << 6) // x is 2-bit
#define FXOS8700CQ_CTRL_REG1_DR3(x) (x << 3) // x is 3-bit
#define FXOS8700CQ_CTRL_REG1_LNOISE (1 << 2)
#define FXOS8700CQ_CTRL_REG1_F_READ (1 << 1)
#define FXOS8700CQ_CTRL_REG1_ACTIVE (1 << 0)

#define FXOS8700CQ_CTRL_REG2_ST (1 << 7)
#define FXOS8700CQ_CTRL_REG2_RST (1 << 6)
#define FXOS8700CQ_CTRL_REG2_SMODS2(x) (x << 3) // x is 2-bit
#define FXOS8700CQ_CTRL_REG2_SLPE (1 << 2)
#define FXOS8700CQ_CTRL_REG2_MODS2(x) (x << 0) // x is 2-bit

#define FXOS8700CQ_CTRL_REG3_FIFO_GATE (1 << 7)
#define FXOS8700CQ_CTRL_REG3_WAKE_TRANS (1 << 6)
#define FXOS8700CQ_CTRL_REG3_WAKE_LNDPRT (1 << 5)
#define FXOS8700CQ_CTRL_REG3_WAKE_PULSE (1 << 4)
#define FXOS8700CQ_CTRL_REG3_WAKE_FFMT (1 << 3)
#define FXOS8700CQ_CTRL_REG3_WAKE_A_VECM (1 << 2)
#define FXOS8700CQ_CTRL_REG3_IPOL (1 << 1)
#define FXOS8700CQ_CTRL_REG3_PP_OD (1 << 0)

#define FXOS8700CQ_CTRL_REG4_INT_EN_ASLP (1 << 7)
#define FXOS8700CQ_CTRL_REG4_INT_EN_FIFO (1 << 6)
#define FXOS8700CQ_CTRL_REG4_INT_EN_TRANS (1 << 5)
#define FXOS8700CQ_CTRL_REG4_INT_EN_LNDPRT (1 << 4)
#define FXOS8700CQ_CTRL_REG4_INT_EN_PULSE (1 << 3)
#define FXOS8700CQ_CTRL_REG4_INT_EN_FFMT (1 << 2)
#define FXOS8700CQ_CTRL_REG4_INT_EN_A_VECM (1 << 1)
#define FXOS8700CQ_CTRL_REG4_INT_EN_DRDY (1 << 0)

#define FXOS8700CQ_CTRL_REG5_INT_CFG_ASLP (1 << 7)
#define FXOS8700CQ_CTRL_REG5_INT_CFG_FIFO (1 << 6)
#define FXOS8700CQ_CTRL_REG5_INT_CFG_TRANS (1 << 5)
#define FXOS8700CQ_CTRL_REG5_INT_CFG_LNDPRT (1 << 4)
#define FXOS8700CQ_CTRL_REG5_INT_CFG_PULSE (1 << 3)
#define FXOS8700CQ_CTRL_REG5_INT_CFG_FFMT (1 << 2)
#define FXOS8700CQ_CTRL_REG5_INT_CFG_A_VECM (1 << 1)
#define FXOS8700CQ_CTRL_REG5_INT_CFG_DRDY (1 << 0)

#define FXOS8700CQ_XYZ_DATA_CFG_HPF_OUT (1 << 4)
#define FXOS8700CQ_XYZ_DATA_CFG_FS2(x) (x << 0) // x is 2-bit

#define FXOS8700CQ_M_CTRL_REG1_M_ACAL (1 << 7)
#define FXOS8700CQ_M_CTRL_REG1_M_RST (1 << 6)
#define FXOS8700CQ_M_CTRL_REG1_M_OST (1 << 5)
#define FXOS8700CQ_M_CTRL_REG1_MO_OS3(x) (x << 2) // x is 3-bit
#define FXOS8700CQ_M_CTRL_REG1_M_HMS2(x) (x << 0) // x is 2-bit

#define FXOS8700CQ_M_CTRL_REG2_HYB_AUTOINC_MODE (1 << 5)
#define FXOS8700CQ_M_CTRL_REG2_M_MAXMIN_DIS (1 << 4)
#define FXOS8700CQ_M_CTRL_REG2_M_MAXMIN_DIS_THS (1 << 3)
#define FXOS8700CQ_M_CTRL_REG2_M_MAXMIN_RST (1 << 2)
#define FXOS8700CQ_M_CTRL_REG2_M_RST_CNT2(x) (x << 0) // x is 2-bit

#define FXOS8700CQ_M_CTRL_REG3_M_RAW (1 << 7)
#define FXOS8700CQ_M_CTRL_REG3_M_ASLP_OS3(x) (x << 4) // x is 3-bit
#define FXOS8700CQ_M_CTRL_REG3_M_THS_XYZ_UPDATE (1 << 3)
#define FXOS8700CQ_M_CTRL_REG3_M_ST_Z (1 << 2)
#define FXOS8700CQ_M_CTRL_REG3_M_ST_XY2(x) (x << 0) // x is 2-bit

// FXOS8700CQ WHOAMI production register value
#define FXOS8700CQ_WHOAMI_VAL 0xC7






#endif /* SRC_ACC_BOARD_DEF_H_ */
```

## src/led_axis.c
```c
/**
 * @brief FTF Zephyr DEMO open led device driver and use acc result to light it
 */

#include <stdio.h>
#include <stdint.h>
#include <zephyr.h>
#include <misc/printk.h>
#include <device.h>
#include <gpio.h>

/* define acc scale factor for +- 4g */
#define ACC_CONVERSION_FACTOR_4G 0.000488f

/* gpio device driver instances */
struct device *gpiob_dev;
struct device *gpioe_dev;

/* instance a semaphore */
K_SEM_DEFINE(sync,0,1);


/**
 * @brief light led when accelerometer gets aligned
 */
void led_thread (void)
{
	extern int16_t x;
	extern int16_t y;
	extern int16_t z;


	gpiob_dev = device_get_binding("GPIO_1");
	if(gpiob_dev != NULL) {
		printk("Opened gpio driver succesfull! \n\r");
	} else {
		printk("Failed to  open gpio driver! \n\r");
		return;
	}

	gpioe_dev = device_get_binding("GPIO_4");
	if(gpioe_dev != NULL) {
		printk("Opened gpio driver succesfull! \n\r");
	} else {
		printk("Failed to  open gpio driver! \n\r");
		return;
	}


	gpio_pin_configure(gpiob_dev, 22, GPIO_DIR_OUT);
	gpio_pin_configure(gpiob_dev, 21, GPIO_DIR_OUT);
	gpio_pin_configure(gpioe_dev, 26, GPIO_DIR_OUT);

	gpio_pin_write(gpiob_dev, 22, 1);
	gpio_pin_write(gpiob_dev, 21, 1);
	gpio_pin_write(gpioe_dev, 26, 1);



	for(;;){
		volatile float gx, gy, gz;

		/* waits for a semaphore from accel */
		k_sem_take(&sync, TICKS_UNLIMITED);

		/* calculate the acceleration based in g value */
		gx = (float)x * ACC_CONVERSION_FACTOR_4G;
		gy = (float)y * ACC_CONVERSION_FACTOR_4G;
		gz = (float)z * ACC_CONVERSION_FACTOR_4G;

		if((gx > 0.9f) || (gx < -0.9f)) {
			gpio_pin_write(gpiob_dev, 22, 0);
		} else {
			gpio_pin_write(gpiob_dev, 22, 1);
		}

		if((gy > 0.9f) || (gy < -0.9f)) {
			gpio_pin_write(gpioe_dev, 26, 0);
		} else {
			gpio_pin_write(gpioe_dev, 26, 1);
		}

		if((gz > 0.9f) || (gz < -0.9f)) {
			gpio_pin_write(gpiob_dev, 21, 0);
		} else {
			gpio_pin_write(gpiob_dev, 21, 1);
		}

	}
}
```
